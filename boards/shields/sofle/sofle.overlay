&gpio0 {
    extpwr_pull: extpwr_pull {
        gpio-hog;
        gpios = <13 GPIO_ACTIVE_HIGH>;  // might need to swap this or the next, not sure
        output-low;
        line-name = "Disable ext power pin";
    };
};